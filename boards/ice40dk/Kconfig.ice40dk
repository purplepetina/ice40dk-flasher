## boards/ice40dk/board.yml
```yaml
board:
  name: ice40dk
  full_name: ICE40DK Programmer
  vendor: dkbuilder
  socs:
    - name: stm32f103xb
```

## dts/bindings/memory/winbond,w25q16.yaml
```yaml
description: Winbond W25Q16 SPI flash used as a plain SPI device
compatible: "winbond,w25q16"
include: spi-device.yaml
```
